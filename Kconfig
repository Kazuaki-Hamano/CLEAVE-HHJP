## Kconfig
```kconfig
rsource "src/pinnacle/Kconfig"
rsource "modules/ble-management/Kconfig"
rsource "modules/settings-rpc/Kconfig"
rsource "modules/default-layer/Kconfig"
```

## config/boards/shields/cleave_hhjp/Kconfig.defconfig
```kconfig
# Copyright (c) 2025
# SPDX-License-Identifier: MIT

if SHIELD_CLEAVE_HHJP_LEFT

config ZMK_KEYBOARD_NAME
	default "CLEAVE HHJP"

config ZMK_SPLIT_ROLE_CENTRAL
	default y

config ZMK_SPLIT_BLE_CENTRAL_PERIPHERALS
	default 1

config BT_MAX_CONN
	default 5

endif

if SHIELD_CLEAVE_HHJP_RIGHT

# The physical trackpad is on the peripheral; input-split forwards it to the left.
config ZMK_POINTING
	default y

config SPI
	default y

config BT_GATT_CLIENT
	default y

endif

if SHIELD_CLEAVE_HHJP_LEFT || SHIELD_CLEAVE_HHJP_RIGHT

config ZMK_SPLIT
	default y

endif
```

## config/west.yml
```yaml
manifest:
  remotes:
    - name: cormoran
      url-base: https://github.com/cormoran
    - name: caksoylar
      url-base: https://github.com/caksoylar
  projects:
    - name: zmk
      remote: cormoran
      revision: e5c9b6915b56801193e359dd9bad4a167ce0d1b8 # main+dya
      import: app/west.yml
    - name: zephyr
      remote: cormoran
      revision: 63363d92c475ad203b35e9047cef7ecd8706a6fc # v4.1.0+zmk-fixes+nrf-half-duplex-uart
      clone-depth: 1
      import:
        name-blocklist: [ci-tools, hal_altera, hal_cypress, hal_infineon, hal_microchip, hal_nxp, hal_openisa, hal_xtensa, hal_st, hal_ti, loramac-node, mcuboot, mcumgr, net-tools, openthread, edtt, trusted-firmware-m]
    - name: zmk-feature-custom-settings
      remote: cormoran
      revision: c6a7fef3a3be3d3ace5de9a4b0628c6418cd1f3f # main
    - name: zmk-feature-fast-keymap
      remote: cormoran
      revision: 21d9af3c2ad694f823ad007b361b091c1e366eee # main
    - name: zmk-feature-runtime-macro
      remote: cormoran
      revision: 38530962eb7061b60efcb98e84585cfb1f0cb6de # main
    - name: zmk-feature-runtime-combo
      remote: cormoran
      revision: d9490e7b5d41c516221d131241009e81740efcee # main
    - name: zmk-feature-input-stream
      remote: cormoran
      revision: aeb015908a42a7615ccdccc7feb3a10d23132a71 # main
    - name: zmk-feature-module-physical-layout
      remote: cormoran
      revision: 4f18de45dc27820725d267916b4cdacc0e0b6cf9 # main
    - name: zmk-feature-device-info
      remote: cormoran
      revision: 8cedd2dd9f04e19ea5a17b94914dd47a09d8db11 # inspected diagnostic module
    - name: zmk-feature-kscan-diagnostics
      remote: cormoran
      revision: 1432f7fe0cfe903cd7d3c9931ae6bd6f2e1f328e # inspected diagnostic module
    - name: zmk-feature-watchdog
      remote: cormoran
      revision: 84ad14c6c3645dc40b23f45d08ab45418655f912 # inspected stability diagnostics
    - name: zmk-module-devtool
      remote: cormoran
      revision: 9938a2c73c06d6e65ba2c0b68c9aa044a467eafc # inspected stability diagnostics
    - name: zmk-rgbled-widget
      remote: caksoylar
      revision: e6b467792a1dabef8cfa5c9fd26bfefc9c16662b # Zephyr 4.1 / current endpoint API
  self:
    path: config
```

## dts/bindings/behaviors/cleave,behavior-mouse-speed.yaml
```yaml
description: Select mouse speed or hold a temporary speed modifier
compatible: "cleave,behavior-mouse-speed"
include: one_param.yaml
```

## dts/bindings/behaviors/cleave,behavior-trackpad-settings.yaml
```yaml
description: Forward a runtime trackpad sensitivity request to the peripheral
compatible: "cleave,behavior-trackpad-settings"
include: one_param.yaml
```

## dts/bindings/behaviors/cleave,studio-ble-discovery.yaml
```yaml
description: Open a temporary Studio BLE discovery window
compatible: "cleave,behavior-studio-ble-discovery"
include: zero_param.yaml
```

## dts/bindings/input/cleave,pinnacle-spi.yaml
```yaml
description: |
  Sensor driver for the Cirque Pinnacle trackpad ASICs, using the SPI interface

compatible: "cleave,pinnacle"

include: ["spi-device.yaml", "cleave,pinnacle-common.yaml"]
```

## dts/bindings/input_processors/cleave,input-processor-mouse-speed.yaml
```yaml
description: Scale keyboard mouse movement using the selected speed and held modifiers
compatible: "cleave,input-processor-mouse-speed"
include: ip_zero_param.yaml
```

## dts/bindings/input_processors/cleave,input-processor-trackpad.yaml
```yaml
description: Runtime-configurable trackpad speed and acceleration
compatible: "cleave,input-processor-trackpad"
include: ip_zero_param.yaml
```

## src/pinnacle/Kconfig
```kconfig
# Copyright (c) 2022 The ZMK Contributors
# SPDX-License-Identifier: MIT

menuconfig CLEAVE_INPUT_PINNACLE
    bool "Cirque Pinnacle trackpads"
    default y
    depends on GPIO
    depends on SPI || I2C
    depends on INPUT
    depends on DT_HAS_CLEAVE_PINNACLE_ENABLED
    help
      Enable driver for Cirque Pinnacle trackpads

if CLEAVE_INPUT_PINNACLE

config CLEAVE_INPUT_PINNACLE_INIT_PRIORITY
    int "Cirque Pinnacle initialization priority"
    default INPUT_INIT_PRIORITY

endif
```
